## boards/shields/mittens/Kconfig.shield
```kconfig
config SHIELD_MITTENS_LEFT
    def_bool $(shields_list_contains,mittens_left)

# No whitespace after the comma or in your part name!
config SHIELD_MITTENS_RIGHT
    def_bool $(shields_list_contains,mittens_right)
```
